## firmware/main/Kconfig.projbuild
```kconfig
menu "JATAYU"

config JATAYU_NODE_ID
    string "Node identifier reported to the Pi"
    default "jatayu_rx_01"
    help
        Included in the startup banner and every health line so the backend
        can tell nodes apart once more than one receiver is deployed.

config JATAYU_ROUTER_MODE
    bool "Use router / phone hotspot as CSI transmitter"
    default y
    help
        Connect to an AP and ping its gateway at the configured rate. Disable
        only when using Espressif's stock csi_send on a second ESP32.

config JATAYU_WIFI_SSID
    string "Wi-Fi network name (SSID, 2.4 GHz)"
    default "JATAYU"
    depends on JATAYU_ROUTER_MODE
    help
        The ESP32-S3 is 2.4 GHz only. On an iPhone hotspot enable
        "Maximize Compatibility"; on Android pick the 2.4 GHz band.
        tools/build-flash.ps1 fills this from firmware/sdkconfig.wifi.

config JATAYU_WIFI_PASSWORD
    string "Wi-Fi password"
    default ""
    depends on JATAYU_ROUTER_MODE
    help
        Leave empty for an open network.

config JATAYU_PING_HZ
    int "Router ping / CSI sample rate (Hz)"
    range 10 150
    default 100
    depends on JATAYU_ROUTER_MODE

config JATAYU_FORCE_HT20
    bool "Request 20 MHz frames from the AP"
    default y
    depends on JATAYU_ROUTER_MODE
    help
        Keeps every CSI packet at 64 subcarriers. Mixed 20/40 MHz traffic
        otherwise produces two different row widths.

config JATAYU_DIRECT_CHANNEL
    int "Fixed Wi-Fi channel for dedicated ESP-NOW transmitter"
    range 5 11
    default 11
    depends on !JATAYU_ROUTER_MODE
    help
        Matches the HT40 secondary-channel-below arrangement in Espressif's
        stock csi_send example. Change the sender and receiver together.

choice JATAYU_GAIN_MODE
    prompt "Receiver gain (AGC) handling"
    default JATAYU_GAIN_COMPENSATE
    help
        Automatic gain control rescales CSI amplitude whenever it steps,
        which looks exactly like body motion. Compensation (Espressif's
        recommended approach) divides each packet by its gain change.

config JATAYU_GAIN_COMPENSATE
    bool "Compensate every packet for AGC/FFT gain changes (recommended)"

config JATAYU_GAIN_FORCE
    bool "Lock the receiver gain at the measured baseline (may lose packets)"

config JATAYU_GAIN_OFF
    bool "Raw amplitudes, no gain handling"

endchoice

endmenu
```
